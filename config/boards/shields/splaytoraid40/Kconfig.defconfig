## config/boards/shields/splaytoraid40/Kconfig.defconfig
```kconfig
# Copyright (c) 2021 The ZMK Contributors
# SPDX-License-Identifier: MIT

if SHIELD_SPLAYTORAID40

config ZMK_KEYBOARD_NAME
    default "splaytoraid40"

endif
```

## config/boards/shields/splaytoraid40/Kconfig.shield
```kconfig
# Copyright (c) 2021 The ZMK Contributors
# SPDX-License-Identifier: MIT

config SHIELD_SPLAYTORAID40
    def_bool $(shields_list_contains,splaytoraid40)
```
